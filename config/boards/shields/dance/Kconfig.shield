## config/boards/shields/dance/Kconfig.shield
```kconfig
config SHIELD_DANCE_LEFT
    def_bool $(shields_list_contains,dance_left)

config SHIELD_DANCE_RIGHT
    def_bool $(shields_list_contains,dance_right)
```

## config/boards/shields/roco/Kconfig.defconfig
```kconfig
if SHIELD_ROCO40

config ZMK_KEYBOARD_NAME
    default "roco40"

CONFIG_EC11=y
CONFIG_EC11_TRIGGER_GLOBAL_THREAD=y

endif
```
